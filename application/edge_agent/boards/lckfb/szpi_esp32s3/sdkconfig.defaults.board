## application/edge_agent/boards/lckfb/szpi_esp32s3/sdkconfig.defaults.board
```kconfig
CONFIG_ESP_DEFAULT_CPU_FREQ_MHZ_240=y
CONFIG_ESPTOOLPY_FLASHMODE_QIO=y
CONFIG_ESPTOOLPY_FLASHFREQ_80M=y
CONFIG_ESPTOOLPY_FLASHSIZE_16MB=y
CONFIG_PARTITION_TABLE_CUSTOM=y
CONFIG_PARTITION_TABLE_CUSTOM_FILENAME="partitions_16MB.csv"
CONFIG_SPIRAM=y
CONFIG_SPIRAM_MODE_OCT=y
CONFIG_SPIRAM_SPEED_80M=y

CONFIG_APP_CLAW_LUA_MODULE_AUDIO=y
CONFIG_APP_CLAW_LUA_MODULE_BOARD_MANAGER=y
CONFIG_APP_CLAW_LUA_MODULE_CAMERA=y
CONFIG_APP_CLAW_LUA_MODULE_LCD=y
CONFIG_APP_CLAW_LUA_MODULE_LCD_TOUCH=y
CONFIG_APP_CLAW_LUA_MODULE_IMU=y
CONFIG_LUA_MODULE_IMU_CHIP_QMI8658=y
CONFIG_APP_CLAW_LUA_MODULE_SDMMC=y

# Keep IDF 5.x driver_ng I2C users from tripping the legacy driver constructor.
CONFIG_I2C_SKIP_LEGACY_CONFLICT_CHECK=y

# On-board DVP camera sensor.
CONFIG_CAMERA_GC0308=y
CONFIG_CAMERA_GC0308_AUTO_DETECT_DVP_INTERFACE_SENSOR=y
CONFIG_CAMERA_GC0308_DVP_YUV422_YUYV_640X480_16FPS=y
CONFIG_CAMERA_GC0308_DVP_DEFAULT_FMT_YUV422_640X480_16FPS=y
```
